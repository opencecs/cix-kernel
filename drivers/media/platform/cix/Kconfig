## drivers/media/platform/cix/Kconfig
```kconfig
# SPDX-License-Identifier: GPL-2.0-only
source "drivers/media/platform/cix/linlon-aeu/Kconfig"

config VIDEO_LINLON
	tristate "CiX Linlon VPU driver (amvx)"
	depends on VIDEO_DEV
	select VIDEOBUF2_DMA_SG
	select FW_LOADER
	help
	  V4L2 stateful memory-to-memory driver for the CiX Linlon VPU.
	  Provides H.264/HEVC hardware encode and decode.
```

## drivers/misc/rockchip-rkep/Kconfig
```kconfig
# SPDX-License-Identifier: GPL-2.0
config MYT_RK182X
	tristate "Rockchip RK182X PCIe endpoint driver"
	depends on PCI && ARM64 && IOMMU_DMA
	default m
	help
	  Build the Rockchip pcie-rkep host driver for external RK182X cards.
	  The driver exposes a pcie-rkep device node for each bound PCI
	  function. Endpoint userspace and firmware are supplied separately.
```

## drivers/misc/xh2a/Kconfig
```kconfig
# SPDX-License-Identifier: GPL-2.0
#
# Houmo XH2A NPU driver configuration
#

config XH2A_DRV
	tristate "Houmo XH2A NPU host driver"
	depends on PCI
	depends on ARM64
	default y
	help
	  This driver provides support for the Houmo XH2A (LQ50) NPU
	  compute card connected via PCIe. It includes PCIe communication,
	  memory allocator, IPU, QSPI, I2C, and RPMsg Lite sub-modules.

	  Choose Y to build the driver into the kernel, or M to build
	  it as a loadable module (xh2a_drv.ko).

	  If unsure, say Y.

config XH2A_KEEP_AWAKE_BY_DEFAULT
	bool "Keep detected XH2A devices active when idle"
	depends on XH2A_DRV
	help
	  Keep each detected card ready for its next transfer. This trades idle
	  power for lower first-transfer latency. The runtime_pm_enable module
	  parameter can override the default. If unsure, say N.
```

## drivers/soc/cix/ap/Kconfig
```kconfig
# SPDX-License-Identifier: GPL-2.0-only
config OPENCECS_LIFECYCLE_EMERGENCY
 bool "OpenCecs PID1-only explicit emergency restart"
 depends on ARM64 && ARCH_CIX && ARM_PSCI_FW
 depends on PLAT_REBOOT_REASON && SKY1_REBOOT_REASON
 default n
 help
   Built-in private emergency restart entry for OpenCecs PID1. Bypasses
   blocking reboot notifiers, device shutdown and the global reboot mutex.
   Only explicit acknowledged emergency operations are accepted. Ordinary
   reboot(2) is unchanged. Hardware/firmware hard locks may still prevent reset.
```
